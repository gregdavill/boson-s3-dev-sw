## buildroot/Config.in
```kconfig
source "$BR2_EXTERNAL_BOSONS3DEV_PATH/package/boson_power/Config.in"
source "$BR2_EXTERNAL_BOSONS3DEV_PATH/package/libuvc/Config.in"
source "$BR2_EXTERNAL_BOSONS3DEV_PATH/package/rtsp_server/Config.in"
source "$BR2_EXTERNAL_BOSONS3DEV_PATH/package/cedar/Config.in"
source "$BR2_EXTERNAL_BOSONS3DEV_PATH/package/cedar-autostart/Config.in"
source "$BR2_EXTERNAL_BOSONS3DEV_PATH/package/ifplugd_systemd_service/Config.in"
source "$BR2_EXTERNAL_BOSONS3DEV_PATH/package/ifupdown_hotplug/Config.in"
```

## buildroot/configs/boson_s3_dev_defconfig
```kconfig
BR2_arm=y
BR2_cortex_a7=y
BR2_ARM_FPU_NEON_VFPV4=y
BR2_CCACHE=y
BR2_TOOLCHAIN_EXTERNAL=y
BR2_TARGET_GENERIC_HOSTNAME="boson-s3"
BR2_TARGET_GENERIC_ISSUE="Welcome to Boson-S3!"
BR2_INIT_SYSTEMD=y
BR2_TARGET_GENERIC_ROOT_PASSWD="dev"
BR2_SYSTEM_DEFAULT_PATH="/bin:/sbin:/usr/bin:/usr/sbin"
BR2_ROOTFS_POST_BUILD_SCRIPT="$(BR2_EXTERNAL_BOSONS3DEV_PATH)/board/gsd/boson-s3-dev/post_build.sh"
BR2_ROOTFS_POST_IMAGE_SCRIPT="support/scripts/genimage.sh"
BR2_ROOTFS_POST_SCRIPT_ARGS="-c $(BR2_EXTERNAL_BOSONS3DEV_PATH)/board/gsd/boson-s3-dev/genimage.cfg"
BR2_LINUX_KERNEL=y
BR2_LINUX_KERNEL_CUSTOM_VERSION=y
BR2_LINUX_KERNEL_CUSTOM_VERSION_VALUE="5.18"
BR2_LINUX_KERNEL_PATCH="$(BR2_EXTERNAL_BOSONS3DEV_PATH)/board/gsd/boson-s3-dev/linux/patches"
BR2_LINUX_KERNEL_USE_CUSTOM_CONFIG=y
BR2_LINUX_KERNEL_CUSTOM_CONFIG_FILE="$(BR2_EXTERNAL_BOSONS3DEV_PATH)/board/gsd/boson-s3-dev/linux/defconfig"
BR2_LINUX_KERNEL_DTS_SUPPORT=y
BR2_LINUX_KERNEL_CUSTOM_DTS_PATH="$(BR2_EXTERNAL_BOSONS3DEV_PATH)/board/gsd/boson-s3-dev/dts/sun8i-s3-boson-s3-dev.dts"
BR2_LINUX_KERNEL_NEEDS_HOST_OPENSSL=y
BR2_PACKAGE_LINUX_TOOLS_CPUPOWER=y
BR2_PACKAGE_LINUX_TOOLS_GPIO=y
BR2_PACKAGE_LINUX_TOOLS_TMON=y
BR2_PACKAGE_FFMPEG=y
BR2_PACKAGE_FFMPEG_GPL=y
BR2_PACKAGE_FFMPEG_NONFREE=y
BR2_PACKAGE_FFMPEG_ENCODERS="cedrus264"
BR2_PACKAGE_FFMPEG_DECODERS="rawvideo"
BR2_PACKAGE_MJPEGTOOLS=y
BR2_PACKAGE_MTD=y
# BR2_PACKAGE_MTD_NANDDUMP is not set
# BR2_PACKAGE_MTD_NANDTEST is not set
# BR2_PACKAGE_MTD_NANDWRITE is not set
# BR2_PACKAGE_MTD_UBIATTACH is not set
# BR2_PACKAGE_MTD_UBICRC32 is not set
# BR2_PACKAGE_MTD_UBIDETACH is not set
# BR2_PACKAGE_MTD_UBIFORMAT is not set
# BR2_PACKAGE_MTD_UBIHEALTHD is not set
# BR2_PACKAGE_MTD_UBIMKVOL is not set
# BR2_PACKAGE_MTD_UBINFO is not set
# BR2_PACKAGE_MTD_UBINIZE is not set
# BR2_PACKAGE_MTD_UBIRENAME is not set
# BR2_PACKAGE_MTD_UBIRMVOL is not set
# BR2_PACKAGE_MTD_UBIRSVOL is not set
# BR2_PACKAGE_MTD_UBIUPDATEVOL is not set
# BR2_PACKAGE_MTD_UBIBLOCK is not set
BR2_PACKAGE_XORG7=y
BR2_PACKAGE_RNG_TOOLS=y
BR2_PACKAGE_GNUTLS=y
BR2_PACKAGE_LIBGUDEV=y
BR2_PACKAGE_LIBUSB=y
BR2_PACKAGE_LIBV4L=y
BR2_PACKAGE_LIBV4L_UTILS=y
BR2_PACKAGE_LIBMPEG2=y
BR2_PACKAGE_LIBYUV=y
BR2_PACKAGE_OPENSSH=y
BR2_TARGET_ROOTFS_EXT2=y
BR2_TARGET_ROOTFS_EXT2_4=y
BR2_TARGET_ROOTFS_EXT2_SIZE="256M"
BR2_TARGET_UBOOT=y
BR2_TARGET_UBOOT_BUILD_SYSTEM_KCONFIG=y
BR2_TARGET_UBOOT_CUSTOM_VERSION=y
BR2_TARGET_UBOOT_CUSTOM_VERSION_VALUE="2022.04"
BR2_TARGET_UBOOT_PATCH="$(BR2_EXTERNAL_BOSONS3DEV_PATH)/board/gsd/boson-s3-dev/u-boot/patches/"
BR2_TARGET_UBOOT_BOARD_DEFCONFIG="gsd-boson-dev"
BR2_TARGET_UBOOT_NEEDS_DTC=y
BR2_TARGET_UBOOT_NEEDS_PYLIBFDT=y
# BR2_TARGET_UBOOT_FORMAT_BIN is not set
BR2_TARGET_UBOOT_FORMAT_CUSTOM=y
BR2_TARGET_UBOOT_FORMAT_CUSTOM_NAME="u-boot-sunxi-with-spl.bin"
BR2_PACKAGE_HOST_DOSFSTOOLS=y
BR2_PACKAGE_HOST_GENIMAGE=y
BR2_PACKAGE_HOST_MTOOLS=y
BR2_PACKAGE_HOST_QEMU=y
BR2_PACKAGE_HOST_UBOOT_TOOLS=y
BR2_PACKAGE_HOST_UBOOT_TOOLS_BOOT_SCRIPT=y
BR2_PACKAGE_HOST_UBOOT_TOOLS_BOOT_SCRIPT_SOURCE="$(BR2_EXTERNAL_BOSONS3DEV_PATH)/board/gsd/boson-s3-dev/boot.cmd"
BR2_PACKAGE_BOSON_POWER=y
BR2_PACKAGE_LIBUVC=y
BR2_PACKAGE_RTSP_SERVER=y
BR2_PACKAGE_RTSP_SERVER_AUTOSTART=y
BR2_PACKAGE_CEDAR=y
BR2_PACKAGE_CEDAR_AUTOSTART=y
BR2_PACKAGE_IFPLUGD_SYSTEMD_SERVICE=y
```

## buildroot/package/bluetooth_en/Config.in
```kconfig
config BR2_PACKAGE_BLUETOOTH_EN
	bool "bluetooth-en"
	help
	  Add /var/lib/bluetoth dir needed 
```

## buildroot/package/boson_power/Config.in
```kconfig
config BR2_PACKAGE_BOSON_POWER
       bool "Boson Power"
       help
         Boson Power Service
```

## buildroot/package/cedar-autostart/Config.in
```kconfig
config BR2_PACKAGE_CEDAR_AUTOSTART
       bool "Cedar Autostart"
       help
         Load Cedar Kernel Module
```

## buildroot/package/mediamtx/Config.in
```kconfig
config BR2_PACKAGE_MEDIAMTX
	bool "mediamtx"
	depends on BR2_PACKAGE_HOST_GO_TARGET_ARCH_SUPPORTS
	help
	  MediaMTX (formerly rtsp-simple-server) is a ready-to-use and 
	  zero-dependency real-time media server and media proxy that 
	  allows to publish, read, proxy, record and playback video and 
	  audio streams.
```

## buildroot/package/mediamtx_autostart/Config.in
```kconfig
config BR2_PACKAGE_MEDIAMTX_AUTOSTART
       bool "MEDIAMTX autostart service"
       help
         Install service for mediamtx
```

## buildroot/package/rtsp_server_autostart/Config.in
```kconfig
config BR2_PACKAGE_RTSP_SERVER_AUTOSTART
       bool "rtsp_server Autostart"
       help
         Autorun rtsp_server
```
